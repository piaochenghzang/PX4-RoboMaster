## src/drivers/ftservo/Kconfig
```kconfig
menuconfig DRIVERS_FTSERVO
	bool "FTServo serial bus servo driver"
	default n
	---help---
		Enable the FEETECH SMS/STS serial bus servo driver.
```

## src/modules/arm_control/Kconfig
```kconfig
menuconfig MODULES_ARM_CONTROL
    bool "arm_control"
    default n
	---help---
		Enable support for arm_control
```
